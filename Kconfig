## Kconfig
```kconfig
mainmenu "X-kernel Configuration"

choice
    prompt "Build Type"
    default BUILD_TYPE_RELEASE

config BUILD_TYPE_RELEASE
    bool "Release Build"
    help
      A release build with optimizations enabled and debug information disabled.
config BUILD_TYPE_DEBUG
    bool "Debug Build"
    help
        A debug build with optimizations disabled and debug information enabled.
endchoice

choice
    prompt "LOG Level"
    default LOG_LEVEL_WARN

config LOG_LEVEL_ERROR
    bool "Error Level Logging"

config LOG_LEVEL_WARN
    bool "Warning Level Logging"

config LOG_LEVEL_INFO
    bool "Info Level Logging"

config LOG_LEVEL_DEBUG
    bool "Debug Level Logging"

config LOG_LEVEL_TRACE
    bool "Trace Level Logging"

endchoice

choice
    prompt "Target Architecture"
    default ARCH_AARCH64

config ARCH_AARCH64
    bool "AArch64 (ARM 64-bit)"

config ARCH_RISCV64
    bool "RISC-V 64-bit"

config ARCH_X86_64
    bool "x86_64"

config ARCH_LOONGARCH64
    bool "LoongArch 64-bit"

endchoice

config ARCH_NAME
    string
    default "$(if $(ARCH_AARCH64),aarch64,$(if $(ARCH_RISCV64),riscv64,$(if $(ARCH_X86_64),x86_64,$(if $(ARCH_LOONGARCH64),loongarch64,unknown)))) )"
    help
      The name of the selected architecture.

menu "Platform Selection"

if ARCH_AARCH64

choice
    prompt "AArch64 Platform"
    default PLATFORM_AARCH64_QEMU_VIRT

config PLATFORM_AARCH64_QEMU_VIRT
    bool "QEMU ARM64 Virtual Machine"

config PLATFORM_AARCH64_CROSVM_VIRT
    bool "CROSVM ARM64 Virtual Machine"

config PLATFORM_AARCH64_RASPI
    bool "Raspberry Pi 4B"

endchoice

config PLATFORM_NAME
    string
    default "$(if $(PLATFORM_AARCH64_QEMU_VIRT),aarch64-qemu-virt,$(if $(PLATFORM_AARCH64_CROSVM_VIRT),aarch64-crosvm-virt,$(if $(PLATFORM_AARCH64_RASPI),raspi4b,unknown))))"

endif # ARCH_AARCH64

if ARCH_RISCV64

choice
    prompt "RISC-V 64 Platform"
    default PLATFORM_RISCV64_QEMU_VIRT

config PLATFORM_RISCV64_QEMU_VIRT
    bool "QEMU RISC-V 64 Virtual Machine"

endchoice

endif # ARCH_RISCV64

if ARCH_X86_64

choice
    prompt "x86_64 Platform"
    default PLATFORM_X86_64_QEMU_VIRT

config PLATFORM_X86_64_QEMU_VIRT
    bool "QEMU x86_64 Virtual Machine"

config PLATFORM_X86_CSV
    bool "x86 CSV Platform"

endchoice

endif # ARCH_X86_64

if ARCH_LOONGARCH64

choice
    prompt "LoongArch64 Platform"
    default PLATFORM_LOONGARCH64_QEMU_VIRT

config PLATFORM_LOONGARCH64_QEMU_VIRT
    bool "QEMU LoongArch64 Virtual Machine"

endchoice

endif # ARCH_LOONGARCH64

endmenu

menu "Kernel Features"

config KERNEL_BASE_PADDR
    hex "Kernel Base Physical Address"
    default 0x80000000
    help
      Specify the base physical address where the kernel is loaded.

config CPU_NUM
    int "Number of CPUs"
    default 4
    help
      Specify the number of CPUs to simulate in the kernel.

config SMP
    bool "Symmetric Multiprocessing (SMP)"
    default y

config FP_SIMD
    bool "Floating Point and SIMD"
    default y

config NET
    bool "Network Stack"
    default y

config FS
    bool "File System Support"
    default y

config IRQ
    bool "Interrupt Support"
    default y

endmenu

source "drivers/Kconfig"
```

## drivers/Kconfig
```kconfig
menu "Drivers Basic Configuration"

config RTC
    bool "RTC Support"
    default y
    help
      Enable support for Real Time Clock (RTC) devices.

config PHYS_BUS_OFFSET
    hex "Physical Bus Offset"
    default 0x0
    help
      Specify the physical bus offset for device memory mapping.

config PCI_ECAM_BASE
    hex "PCI ECAM Base Address"
    default 0x40100000000
    help
      Define the base address for PCI Express Configuration Access Mechanism (ECAM).

config PCI_BUS_END
    hex "PCI Bus End"
    default 0xff
    help
      Set the end bus number for PCI devices.

config PCI_RANGES
    rangetype "PCI Address Ranges"
    default [0x0, 0x1]
    help
      Specify the address ranges for PCI devices.
endmenu
```

## platforms/Kconfig
```kconfig
menu "Platform Basic Configuration"

config PLATFORM_CPU_NUM
    int "Number of CPUs"
    range 1 256
    default 4
    help
      Number of CPUs available on the platform.

config PLATFORM_PHYS_MEM_BASE
    hex "Physical memory base address"
    default 0x40000000
    help
      Base physical address of the system memory.

config PLATFORM_PHYS_MEM_SIZE
    hex "Physical memory size"
    default 0x08000000
    help
      Total size of the physical memory.

config PLATFORM_KERNEL_BASE_PADDR
    hex "Kernel base physical address"
    default 0x40200000
    help
      Physical load address of the kernel image.

config PLATFORM_KERNEL_BASE_VADDR
    hex "Kernel base virtual address"
    default 0xffff000040200000
    help
      Virtual address where the kernel is mapped.

config PLATFORM_PHYS_VIRT_OFFSET
    hex "Physical to virtual address offset"
    default 0xffff000000000000
    help
      Offset used to convert physical addresses to virtual addresses.

config PLATFORM_PHYS_BUS_OFFSET
    hex "Physical to bus address offset"
    default 0x0
    help
      Offset between physical address and bus address.

config PLATFORM_KERNEL_ASPACE_BASE
    hex "Kernel address space base"
    default 0xffff000000000000
    help
      Base address of the kernel virtual address space.

config PLATFORM_KERNEL_ASPACE_SIZE
    hex "Kernel address space size"
    default 0x0000fffffffff000
    help
      Size of the kernel virtual address space.

config PLATFORM_BOOT_STACK_SIZE
    hex "Boot stack size"
    default 0x40000
    help
      Stack size used during kernel boot.

endmenu

menu "Platform DMA and Power Management"

config PLATFORM_DMA_MEM_BASE
    hex "DMA memory base address"
    default 0x40000000
    help
      Base physical address of DMA memory.

config PLATFORM_DMA_MEM_SIZE
    hex "DMA memory size"
    default 0x00200000
    help
      Size of the DMA memory region.

choice
    prompt "PSCI invocation method"
    default PLATFORM_PSCI_HVC

config PLATFORM_PSCI_HVC
    bool "HVC (Hypervisor Call)"
    help
      Use HVC instruction for PSCI calls.

config PLATFORM_PSCI_SMC
    bool "SMC (Secure Monitor Call)"
    help
      Use SMC instruction for PSCI calls.

endchoice

endmenu

menu "Platform Devices and Interrupts"

config PLATFORM_UART_PADDR
    hex "UART physical address"
    default 0x09000000
    help
      Physical address of the UART controller.

config PLATFORM_UART_IRQ
    int "UART IRQ number"
    default 33
    help
      Interrupt number for UART device.

config PLATFORM_TIMER_IRQ
    int "Timer IRQ number"
    default 30
    help
      Interrupt number for the physical timer.

config PLATFORM_IPI_IRQ
    int "IPI IRQ number"
    default 1
    help
      Inter-Processor Interrupt number.

config PLATFORM_PMU_IRQ
    int "PMU IRQ number"
    default 23
    help
      Performance Monitoring Unit interrupt number.

endmenu

menu "Generic Interrupt Controller (GIC)"

config PLATFORM_GICD_PADDR
    hex "GIC Distributor base address"
    default 0x08000000
    help
      Base physical address of the GIC Distributor.

config PLATFORM_GICC_PADDR
    hex "GIC CPU Interface base address"
    default 0x08010000
    help
      Base physical address of the GIC CPU Interface.

endmenu
```

## xtask/xconfig/tests/fixtures/basic/Kconfig
```kconfig
config TEST_BOOL
	bool "Test boolean option"
	default y

config TEST_STRING
	string "Test string option"
	default "hello"

config TEST_INT
	int "Test integer option"
	default 42
```

## xtask/xconfig/tests/fixtures/range_arrays/Kconfig
```kconfig
mainmenu "Test Range Array Configuration"

config TEST_RANGE_NUMBERS
    rangetype "Test numeric range"
    default [1, 2, 3, 4, 5]
    help
      Test range with numbers

config TEST_RANGE_HEX
    rangetype "Test hex range"
    default [0x10, 0x20, 0x30]
    help
      Test range with hex values

config TEST_RANGE_IDENTIFIERS
    rangetype "Test identifier range"
    default [apple, banana, cherry]
    help
      Test range with identifiers

config TEST_RANGE_EMPTY
    rangetype "Empty range"
    default []
    help
      Test empty range

config TEST_RANGE_MIXED
    rangetype "Mixed range"
    default [1, 0x20, value]
    help
      Test mixed values in range
```

## xtask/xconfig/tests/fixtures/range_test/Kconfig
```kconfig
mainmenu "Range Type Test"

config TEST_RANGE_NUMBERS
    rangetype "Test numeric range"
    default [1,2,3,4,5]
    help
      Test range with numbers

config TEST_RANGE_STRINGS
    rangetype "Test string range"
    default [apple,banana,cherry]
    help
      Test range with strings

config TEST_RANGE_HEX
    rangetype "Test hex range"
    default [0x10,0x20,0x30]
    help
      Test range with hex values

config TEST_RANGE_EMPTY
    rangetype "Test empty range"
    default []
    help
      Test empty range

config TEST_NORMAL_INT
    int "Normal integer config"
    default 42
    help
      A normal integer config to verify no regressions
```
